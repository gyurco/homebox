## build/conf/bblayers.conf
```bitbake
# LAYER_CONF_VERSION is increased each time build/conf/bblayers.conf
# changes incompatibly
LCONF_VERSION = "7"

BBPATH = "${TOPDIR}"
BBFILES ?= ""

BBLAYERS ?= " \
  ${TOPDIR}/../openembedded-core/meta \
  ${TOPDIR}/../meta-openembedded/meta-webserver \
  ${TOPDIR}/../meta-openembedded/meta-oe \
  ${TOPDIR}/../meta-openembedded/meta-filesystems \
  ${TOPDIR}/../meta-openembedded/meta-python \
  ${TOPDIR}/../meta-openembedded/meta-perl \
  ${TOPDIR}/../meta-openembedded/meta-networking \
  ${TOPDIR}/../meta-openembedded/meta-multimedia \
  ${TOPDIR}/../meta-virtualization \
  ${TOPDIR}/../meta-yocto/meta-yocto-bsp \
  ${TOPDIR}/../meta-homebox \
  "

BBLAYERS_NON_REMOVABLE ?= " \
  ${TOPDIR}/../openembedded-core/meta \
  "
```

## meta-homebox/conf/distro/homebox.conf
```bitbake
DISTRO_NAME="homebox"
DISTRO_VERSION="0.3"

DISTRO_FEATURES = "alsa bluetooth ext2 usbgadget usbhost wifi nfs pci systemd pam ldap sasl virtualization ${DISTRO_FEATURES_LIBC}"

VIRTUAL-RUNTIME_init_manager = "systemd"

DISTRO_FEATURES_BACKFILL_CONSIDERED = "sysvinit"

LICENSE_FLAGS_WHITELIST = "commercial"

INHERIT += "rm_work"

PREFERRED_VERSION_linux-yocto = "4.15%"

PREFERRED_PROVIDER_jpeg = "libjpeg-turbo"
PREFERRED_PROVIDER_jpeg-native = "libjpeg-turbo-native"

PACKAGECONFIG_pn-mpd = "mad id3tag lame"
PACKAGECONFIG_append_pn-systemd = "networkd"
PACKAGECONFIG_pn-nginx = "http2"
```

## meta-homebox/conf/layer.conf
```bitbake
# We have a conf and classes directory, add to BBPATH
BBPATH .= ":${LAYERDIR}"

# We have recipes-* directories, add to BBFILES
BBFILES += "${LAYERDIR}/recipes-*/*/*.bb ${LAYERDIR}/recipes-*/*/*.bbappend"

BBFILE_COLLECTIONS += "homebox"
BBFILE_PATTERN_homebox = "^${LAYERDIR}/"
BBFILE_PRIORITY_homebox = "1"

# This should only be incremented on significant changes that will
# cause compatibility issues with other layers
LAYERVERSION_homebox = "1"

LAYERDEPENDS_homebox = "core"
```
